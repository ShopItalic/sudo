#include "Cellwise_CW221X_Driver_V1.2.1.h"

#include "bc_logger.h"
#include "bc_fuel_gauge.h"
#include <stdint.h>
#include <stdio.h>
#include "bc_delay.h"

#include "nrf_gpio.h"
#include "nrfx_gpiote.h"

#include "bc_strategy_value.h"
#include "q_device.h"

#define REG_CHIP_ID             0x00
#define REG_VCELL_H             0x02
#define REG_VCELL_L             0x03
#define REG_SOC_INT             0x04
#define REG_SOC_DECIMAL         0x05
#define REG_TEMP                0x06
#define REG_MODE_CONFIG         0x08
#define REG_GPIO_CONFIG         0x0A
#define REG_SOC_ALERT           0x0B
#define REG_TEMP_MAX            0x0C
#define REG_TEMP_MIN            0x0D
#define REG_CURRENT_H           0x0E
#define REG_CURRENT_L           0x0F
#define REG_T_HOST_H            0xA0
#define REG_T_HOST_L            0xA1
#define REG_USER_CONF           0xA2
#define REG_CYCLE_H             0xA4
#define REG_CYCLE_L             0xA5
#define REG_SOH                 0xA6
#define REG_IC_STATE            0xA7
#define REG_STB_CUR_H           0xA8
#define REG_STB_CUR_L           0xA9
#define REG_FW_VERSION          0xAB
#define REG_BAT_PROFILE         0x10

#define CONFIG_MODE_RESTART     0x30
#define CONFIG_MODE_ACTIVE      0x00
#define CONFIG_MODE_SLEEP       0xF0
#define CONFIG_UPDATE_FLG       0x80
#define IC_VCHIP_ID             0xA0
#define IC_READY_MARK           0x0C
#define IC_TEMP_READY           0x08
#define IC_VOL_CUR_READY        0x04

#define SIZE_OF_PROFILE         80

#define USER_RSENSE (100 * 1000)  //rsense * 1000

#define INIT_TEST_TIME      50 /*must >= 50 , can not modify */

#define CW221X_ERROR_IIC      -1
#define CW221X_ERROR_CHIP_ID  -2
#define CW221X_ERROR_TIME_OUT -3
#define CW221X_NOT_ACTIVE          1
#define CW221X_PROFILE_NOT_READY   2
#define CW221X_PROFILE_NEED_UPDATE 3

#define GPIO_SOC_IRQ_VALUE      0x0    /* 0x7F */
#define CW_SLEEP_COUNTS         50

#define CW2215_MARK             0x80
#define CW2217_MARK             0x40
#define CW2218_MARK             0x00

#define CW2215_ADDRESS          0x64

/**************************global**********************************/
static unsigned char config_profile_info[BATT_TYPE_NUM][SIZE_OF_PROFILE] = {
    {//BATT_TYPE_JWLN_155522_12MAH
        0x6E,0x00,0x00,0x00,0x00,0x00,0x00,0x00,
        0xB8,0xC2,0xC7,0xC9,0xC2,0xBE,0xA4,0x6E,
        0x47,0xE2,0xC6,0x92,0x7B,0x68,0x57,0x4A,
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        0x00,0x00,0x00,0x00,0x00,0x00,0x00,0xB0
    },
    {//BATT_TYPE_JWLN_155525_15MAH
        0x6E,0x00,0x00,0x00,0x00,0x00,0x00,0x00,
        0xB6,0xBB,0xC3,0xC7,0xC1,0xB9,0xA9,0x77,
        0x50,0xFF,0xD7,0x9B,0x7A,0x6B,0x57,0x4A,
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        0x00,0x00,0x00,0x00,0x00,0x00,0x00,0x5A
    },
    {//BATT_TYPE_JWLN_155528_18MAH
        0x6E,0x00,0x00,0x00,0x00,0x00,0x00,0x00,
        0xB7,0xB7,0xB1,0xCB,0xB3,0xC2,0x98,0x59,
        0x3C,0xFF,0xFF,0xCD,0xA3,0x86,0x6C,0x5E,
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        0x00,0x00,0x00,0x00,0x00,0x00,0x00,0x7B
    },
    {//BATT_TYPE_JWLN_155522_14MAH
        0x6E, 0x00, 0x00, 0x00, 0x00, 0x00, 0x00, 0x00,
        0xB5, 0xBF, 0xC2, 0xC9, 0xC1, 0xBE, 0x9C, 0x64,
        0x40, 0xFF, 0xDC, 0xA4, 0x88, 0x69, 0x59, 0x4B,
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        0x00, 0x00, 0x00, 0x00, 0x00, 0x00, 0x00, 0x1E
    },
    {//BATT_TYPE_JWLN_155525_16MAH
        0x6E, 0x00, 0x00, 0x00, 0x00, 0x00, 0x00, 0x00,
        0xC4, 0xBF, 0xC1, 0xCB, 0xB8, 0xB5, 0xA9, 0x72,
        0x51, 0xF8, 0xD4, 0xA0, 0x88, 0x6F, 0x5D, 0x50,
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        0x00, 0x00, 0x00, 0x00, 0x00, 0x00, 0x00, 0xE3
    },
    {//BATT_TYPE_JWLN_155528_19MAH
        0x6E, 0x00, 0x00, 0x00, 0x00, 0x00, 0x00, 0x00,
        0xC4, 0xC0, 0xC9, 0xC8, 0xC1, 0xBD, 0xA7, 0x6F,
        0x4F, 0xEC, 0xCA, 0x90, 0x83, 0x64, 0x57, 0x49,
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        0x00, 0x00, 0x00, 0x00, 0x00, 0x00, 0x00, 0x0E
    },
    {//BATT_TYPE_HL_155625_14MAH
        0x6E, 0x00, 0x00, 0x00, 0x00, 0x00, 0x00, 0x00,
        0xBD, 0xC1, 0xC7, 0xCA, 0xC1, 0xBB, 0x9D, 0x69,
        0x45, 0xF6, 0xD0, 0x94, 0x8A, 0x67, 0x59, 0x4F,
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        0x00, 0x00, 0x00, 0x00, 0x00, 0x00, 0x00, 0x7B
    },
    {//BATT_TYPE_HL_155628_16MAH
        0x6E, 0x00, 0x00, 0x00, 0x00, 0x00, 0x00, 0x00,
        0xBB, 0xC3, 0xC2, 0xCA, 0xC2, 0xBB, 0xA1, 0x6A,
        0x43, 0xFB, 0xD6, 0xA2, 0x8F, 0x6F, 0x5F, 0x53,
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        0x00, 0x00, 0x00, 0x00, 0x00, 0x00, 0x00, 0x2C
    },
    {//BATT_TYPE_HL_155634_20MAH
        0x6E, 0x00, 0x00, 0x00, 0x00, 0x00, 0x00, 0x00,
        0xA8, 0xC6, 0xC4, 0xCA, 0xC2, 0xBE, 0xA0, 0x63,
        0x4C, 0xFB, 0xDA, 0xB3, 0x8C, 0x75, 0x61, 0x53,
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        0x00, 0x00, 0x00, 0x00, 0x00, 0x00, 0x00, 0x2A
    },
    {//BATT_TYPE_JWLN_155021_6_12MAH
        0x6E, 0x00, 0x00, 0x00, 0x00, 0x00, 0x00, 0x00,
        0xBA, 0xC8, 0xC6, 0xC7, 0xBD, 0xB4, 0xA9, 0x6F,
        0x4F, 0xCF, 0xBB, 0x97, 0x82, 0x66, 0x58, 0x4E,
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        0x00, 0x00, 0x00, 0x00, 0x00, 0x00, 0x00, 0xDF
    },
    {//BATT_TYPE_JWLN_155021_7_12MAH
        0x6E, 0x00, 0x00, 0x00, 0x00, 0x00, 0x00, 0x00,
        0xB8, 0xC4, 0xC6, 0xCD, 0xC2, 0xBC, 0xA0, 0x69,
        0x46, 0xEF, 0xD1, 0xA6, 0x92, 0x77, 0x65, 0x5A,
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        0x00, 0x00, 0x00, 0x00, 0x00, 0x00, 0x00, 0xE0
    },
    {//BATT_TYPE_JWLN_155026_8_16MAH
        0x6E, 0x00, 0x00, 0x00, 0x00, 0x00, 0x00, 0x00,
        0xB6, 0xC1, 0xC8, 0xCA, 0xC4, 0xC0, 0x98, 0x62,
        0x41, 0xFF, 0xDE, 0xAC, 0x99, 0x79, 0x65, 0x57,
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        0x00, 0x00, 0x00, 0x00, 0x00, 0x00, 0x00, 0x93
    },
    {//BATT_TYPE_JWLN_155026_9_16MAH
        0x6E, 0x00, 0x00, 0x00, 0x00, 0x00, 0x00, 0x00,
        0xB6, 0xC1, 0xC8, 0xCA, 0xC4, 0xC0, 0x98, 0x62,
        0x41, 0xFF, 0xDE, 0xAC, 0x99, 0x79, 0x65, 0x57,
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        0x00, 0x00, 0x00, 0x00, 0x00, 0x00, 0x00, 0x93
    },
    {//BATT_TYPE_JWLN_155031_10_20MAH
        0x6E, 0x00, 0x00, 0x00, 0x00, 0x00, 0x00, 0x00,
        0xA8, 0xC6, 0xC4, 0xCA, 0xC2, 0xBE, 0xA0, 0x63,
        0x4C, 0xFB, 0xDA, 0xB3, 0x8C, 0x75, 0x61, 0x53,
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        0x00, 0x00, 0x00, 0x00, 0x00, 0x00, 0x00, 0x2A
    },
    {//BATT_TYPE_JWLN_155031_11_20MAH
        0x6E, 0x00, 0x00, 0x00, 0x00, 0x00, 0x00, 0x00,
        0xA8, 0xC6, 0xC4, 0xCA, 0xC2, 0xBE, 0xA0, 0x63,
        0x4C, 0xFB, 0xDA, 0xB3, 0x8C, 0x75, 0x61, 0x53,
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        0x00, 0x00, 0x00, 0x00, 0x00, 0x00, 0x00, 0x2A
    },
    {//BATT_TYPE_JWLN_155031_12_20MAH
        0x6E, 0x00, 0x00, 0x00, 0x00, 0x00, 0x00, 0x00,
        0xA8, 0xC6, 0xC4, 0xCA, 0xC2, 0xBE, 0xA0, 0x63,
        0x4C, 0xFB, 0xDA, 0xB3, 0x8C, 0x75, 0x61, 0x53,
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        0x00, 0x00, 0x00, 0x00, 0x00, 0x00, 0x00, 0x2A
    },
    {//BATT_TYPE_JWLN_155031_13_20MAH
        0x6E, 0x00, 0x00, 0x00, 0x00, 0x00, 0x00, 0x00,
        0xA8, 0xC6, 0xC4, 0xCA, 0xC2, 0xBE, 0xA0, 0x63,
        0x4C, 0xFB, 0xDA, 0xB3, 0x8C, 0x75, 0x61, 0x53,
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        0x00, 0x00, 0x00, 0x00, 0x00, 0x00, 0x00, 0x2A
    },
    {//BATT_TYPE_JWLN_150722_18MAH
        0x6E,0x00, 0x00, 0x00, 0x00, 0x00, 0x00, 0x00,
        0xC2, 0xC2, 0xC2, 0xC6, 0xBE, 0xB3, 0xB3, 0x82,
        0x5A, 0xED, 0xCD, 0x9C, 0x80, 0x5F, 0x52, 0x46,
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        0x00, 0x00, 0x00, 0x00, 0x00, 0x00, 0x00, 0xAE
    },
    {//BATT_TYPE_JWLN_150728_25MAH
        0x6E, 0x00, 0x00, 0x00, 0x00, 0x00, 0x00, 0x00,
        0xB4, 0xC2, 0xB7, 0xC4, 0xAC, 0xA7, 0xD1, 0xA1,
        0x84, 0xEB, 0xCE, 0xA3, 0x82, 0x69, 0x58, 0x4D,
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        0x00, 0x00, 0x00, 0x00, 0x00, 0x00, 0x00, 0x30
    },
    {//BATT_TYPE_JWLN_150732_30MAH
        0x6E, 0x00, 0x00, 0x00, 0x00, 0x00, 0x00, 0x00,
        0xAF, 0xBD, 0xB3, 0xCE, 0xC2, 0xBF, 0x9D, 0x5F,
        0x3D, 0xFF, 0xFF, 0xCD, 0x9A, 0x7F, 0x6C, 0x5C,
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        0x00, 0x00, 0x00, 0x00, 0x00, 0x00, 0x00, 0x3E
    },
    {//BATT_TYPE_JWLN_150722_14MAH
        0x6E, 0x00, 0x00, 0x00, 0x00, 0x00, 0x00, 0x00,
        0xC2, 0xBE, 0xC1, 0xC9, 0xC0, 0xB9, 0xA8, 0x74,
        0x54, 0xFF, 0xD8, 0x9E, 0x88, 0x69, 0x5A, 0x4D,
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        0x00, 0x00, 0x00, 0x00, 0x00, 0x00, 0x00, 0xB6,
    },
};

static uint8_t batt_type = 2;

static int cw_read(unsigned char PointReg,unsigned char *pData)
{
    uint8_t res = 0;
    res = !bc_fuel_gauge_i2c_read(CW2215_ADDRESS,PointReg,pData,1);
    
    return res;
}

static int cw_write(unsigned char PointReg,unsigned char *pData)
{
    uint8_t res = 0;
    res = !bc_fuel_gauge_i2c_write(CW2215_ADDRESS,PointReg,pData,1);
    
    return res;
}

static int cw_read_nbyte(unsigned char point_reg,unsigned char *r_pdata, unsigned char len)
{
    uint8_t res = 0;
    res = !bc_fuel_gauge_i2c_read(CW2215_ADDRESS,point_reg,r_pdata,len);
    
    return res;
}

void cw_delay10us(unsigned int us)
{
//    unsigned char a, b;
//    unsigned int i;
//    for(i = 0; i < us; i++){
//        for(b=1; b>0; b--)
//        {
//            for(a=2; a>0; a--);
//        }
//    }
    
//    int i;
//    int j;
//    j=0;
//    for(i=0;i<85;i++)   
//    {
//        j++;
//        i=j;
//    }
    bc_delay_us(10);
}

void cw_delay1ms(unsigned int ms)
{
    bc_delay_ms(ms);
}

int cw221x_read_word(unsigned char point_reg, unsigned int *r_pdata)
{
    int ret = 0;
    unsigned char reg_val[2] = {0 , 0};
    unsigned int temp_val_buff = 0;
    unsigned int temp_val_second = 0;
    
    ret = cw_read_nbyte(point_reg, reg_val, 2);
    if(ret)
        return CW221X_ERROR_IIC;
    temp_val_buff = (reg_val[0] << 8) + reg_val[1];
//    cw_delay10us(100 * 4); /*sleep  >= 4 ms must*/
    cw_delay1ms(4);
    ret = cw_read_nbyte(point_reg, reg_val, 2);
    if(ret)
        return CW221X_ERROR_IIC;
    temp_val_second = (reg_val[0] << 8) + reg_val[1];
    
    if (temp_val_buff != temp_val_second){
//        cw_delay10us(100 * 4); /*sleep  >= 4 ms must*/
        cw_delay1ms(4);
        ret = cw_read_nbyte(point_reg, reg_val, 2);
        if(ret)
            return CW221X_ERROR_IIC;
        temp_val_buff = (reg_val[0] << 8) + reg_val[1];
    }
    
    *r_pdata = temp_val_buff;
    return 0;
}

int cw221x_get_chip_id(int *chip_id)
{
    int ret;
    unsigned char reg_val;
    
    ret = cw_read(REG_CHIP_ID, &reg_val);
    if(ret)
        return CW221X_ERROR_IIC;
    *chip_id = reg_val;
    return 0;
}

static int cw221x_get_state(void)
{
    int ret;
    unsigned char reg_val;
    int i;
    int reg_profile;
    
    ret = cw_read(REG_MODE_CONFIG, &reg_val);
    if(ret)
        return CW221X_ERROR_IIC;
    if (reg_val != CONFIG_MODE_ACTIVE)
        return CW221X_NOT_ACTIVE;
    
    ret = cw_read(REG_SOC_ALERT, &reg_val);
    if (ret)
        return CW221X_ERROR_IIC;
    if (0x00 == (reg_val & CONFIG_UPDATE_FLG))
        return CW221X_PROFILE_NOT_READY;
    
    for (i = 0; i < SIZE_OF_PROFILE; i++) {
        ret = cw_read((REG_BAT_PROFILE + i), &reg_val);
        if (ret)
            return CW221X_ERROR_IIC;
        reg_profile = REG_BAT_PROFILE + i;
        if (config_profile_info[batt_type][i] != reg_val)
            break;
    }
    if ( i != SIZE_OF_PROFILE)
        return CW221X_PROFILE_NEED_UPDATE;
    
    return 0;
}

static int cw221x_write_profile(unsigned char const buf[])
{
    int ret;
    int i;

    for (i = 0; i < SIZE_OF_PROFILE; i++) {
        ret = cw_write(REG_BAT_PROFILE + i, (unsigned char*)&buf[i]);
        if (ret)
            return CW221X_ERROR_IIC;
    }

    return 0;
}

int cw221x_write_temperature(int temperature)
{
    int ret;
    unsigned char A0_value;
    unsigned char A1_value;
    
    if(temperature < -40 || temperature > 87){
        return -1; //write error temperature
    }
    A0_value = (temperature + 40) * 2;
    ret = cw_read(REG_T_HOST_L, &A1_value);
    if (ret)
        return CW221X_ERROR_IIC;
    A1_value = ~A1_value;
    
    ret = cw_write(REG_T_HOST_H, &A0_value);
    if (ret)
        return CW221X_ERROR_IIC;
    ret = cw_write(REG_T_HOST_L, &A1_value);
    if (ret)
        return CW221X_ERROR_IIC;
    return 0;
}

int cw221x_sleep()
{
    int ret;
    unsigned char reg_val = CONFIG_MODE_RESTART;

    ret = cw_write(REG_MODE_CONFIG, &reg_val);
    if (ret)
        return CW221X_ERROR_IIC;
//    cw_delay10us(2 * 1000); /* Here delay must >= 20 ms */
    cw_delay1ms(20);

    reg_val = CONFIG_MODE_SLEEP;
    ret = cw_write(REG_MODE_CONFIG, &reg_val);
    if (ret)
        return CW221X_ERROR_IIC;
//    cw_delay10us(1 * 1000); 
    cw_delay1ms(10);

    return 0;
}

static int cw221x_active()
{
    int ret;
    unsigned char reg_val = CONFIG_MODE_RESTART;

    ret = cw_write(REG_MODE_CONFIG, &reg_val);
    if (ret)
        return CW221X_ERROR_IIC;
//    cw_delay10us(2 * 1000); /* Here delay must >= 20 ms */
    cw_delay1ms(20);

    reg_val = CONFIG_MODE_ACTIVE;
    ret = cw_write(REG_MODE_CONFIG, &reg_val);
    if (ret < 0)
        return CW221X_ERROR_IIC;
//    cw_delay10us(1 * 1000); 
    cw_delay1ms(10);

    return 0;
}

/*CW221X update profile function, Often called during initialization*/
static int cw221x_config_start_ic()
{
    int ret;
    unsigned char reg_val;
    unsigned int voltage = 0;
    int count = 0;

    ret = cw221x_sleep();
    if (ret < 0)
        return ret;

    /* update new battery info */
    ret = cw221x_write_profile(config_profile_info[batt_type]);
    if (ret < 0)
        return ret;

    /* set UPDATE_FLAG AND SOC INTTERRUP VALUE*/
    reg_val = CONFIG_UPDATE_FLG | GPIO_SOC_IRQ_VALUE;   
    ret = cw_write(REG_SOC_ALERT, &reg_val);
    if (ret)
        return CW221X_ERROR_IIC;

    /*close all interruptes*/
    reg_val = 0; 
    ret = cw_write(REG_GPIO_CONFIG, &reg_val); 
    if (ret)
        return CW221X_ERROR_IIC;

    ret = cw221x_active();
    if (ret < 0) 
        return ret;
        
    while(1){
//        cw_delay10us(10 * 1000);
        cw_delay1ms(100);
        ret = cw_read(REG_IC_STATE, &reg_val);
        if (IC_READY_MARK == (reg_val & IC_READY_MARK))
            break;
        count++;
        if (count >= CW_SLEEP_COUNTS) {
            cw221x_sleep();
            return -1;
        }
    }
    
    return 0;
}

static int cw221x_init(void)
{
    int ret;
    int chip_id;

    ret = cw221x_get_chip_id(&chip_id);
    if(ret){
        return ret;
    }
    if(chip_id != IC_VCHIP_ID){
        return CW221X_ERROR_CHIP_ID;
    }

    ret = cw221x_get_state();
    if (ret < 0)
        return ret;
    if (ret != 0) {
        ret = cw221x_config_start_ic();
        if (ret < 0)
            return ret;
    }
    return 0;
}

int cw221x_get_vol(unsigned int *lp_vol)
{
    int ret = 0;
    unsigned int temp_val_buff = 0;
    unsigned int ad_value = 0;
    unsigned char reg_val = 0;

    ret = cw221x_read_word(REG_VCELL_H, &temp_val_buff);
    if(ret)
        return CW221X_ERROR_IIC;
    
    ad_value = temp_val_buff * 5 / 16;
    *lp_vol = ad_value;
    
    return 0; 
}

#define UI_FULL     100
int cw221x_get_capacity(int *lp_uisoc)
{
    int ret = 0;
    unsigned int temp_val_buff = 0;
    int soc = 0;
    int soc_decimal = 0;
    int remainder = 0;
    unsigned int UI_SOC = 0;
    unsigned char reg_val = 0;
    int count = 0;

    ret = cw221x_read_word(REG_SOC_INT, &temp_val_buff);
    if(ret)
        return CW221X_ERROR_IIC;
    
    soc = temp_val_buff >> 8;
    soc_decimal = temp_val_buff & 0xFF;

     UI_SOC = (((unsigned long)soc * 256 + soc_decimal) * 100)/ (UI_FULL * 256);
    remainder = ((((unsigned long)soc * 256 + soc_decimal) * 100 * 100) / (UI_FULL * 256)) % 100;
    
    if(UI_SOC >= 100){
        UI_SOC = 100;
    }
    *lp_uisoc = UI_SOC;
    BC_LOG_INFO("--- %d %d \r\n",temp_val_buff,UI_SOC);
    
    return 0;
}

int cw221x_get_temp(int *lp_temp)
{
    int ret = 0;
    unsigned char reg_val = 0;
    int temp = 0;
    
    ret = cw_read(REG_TEMP, &reg_val);
    if(ret)
        return CW221X_ERROR_IIC;

    temp = (int)reg_val * 10 / 2 - 400;                                           
    *lp_temp = temp;
    
    return 0;
}

long get_complement_code(unsigned short raw_code)
{
    long complement_code = 0;
    int dir = 0;

    if (0 != (raw_code & 0x8000)){
        dir = -1;
        raw_code =  (0XFFFF - raw_code) + 1;
    }
    else{
        dir = 1;
    }

    complement_code = (long)raw_code * dir;

    return complement_code;
}

int cw221x_get_current(long *lp_current)
{
    int ret = 0;
    unsigned short temp_val_buff = 0;
    long cw_current = 0;
    unsigned char reg_val = 0;
    unsigned char fw_version = 0;
    
    ret = cw_read(REG_FW_VERSION, &fw_version);
    if(ret)
        return CW221X_ERROR_IIC;
    
    ret = cw221x_read_word(REG_CURRENT_H, (unsigned int*)&temp_val_buff);
    if(ret)
        return CW221X_ERROR_IIC;

    cw_current = get_complement_code(temp_val_buff);
    
    if(((fw_version & CW2215_MARK) != 0) || ((fw_version & CW2217_MARK) != 0)){
        cw_current = cw_current * 1600 / USER_RSENSE;
    }else if((fw_version != 0) && ((fw_version & 0xC0) == CW2218_MARK)){
        cw_current = cw_current * 3815 / USER_RSENSE;
    }else{
        cw_current = 123456;
        /*Error read FW Version*/
    }

    *lp_current = cw_current;
    return 0;
}

int cw221x_get_cycle_count(int *lp_count)
{
    int ret = 0;
    unsigned int temp_val_buff = 0;
    int cycle_buff = 0;

    ret = cw221x_read_word(REG_CYCLE_H, &temp_val_buff);
    if(ret)
        return CW221X_ERROR_IIC;

    cycle_buff = temp_val_buff/16;
    *lp_count = cycle_buff;
    return 0;
}

int cw221x_get_soh(int *lp_soh)
{
    int ret = 0;
    unsigned char reg_val = 0;
    unsigned char SOH = 0;
    
    ret = cw_read(REG_SOH, &reg_val);
    if(ret)
        return CW221X_ERROR_IIC;

    SOH = reg_val + 5;

    if(SOH >= 100){
        SOH = 100;
    }
    *lp_soh = SOH;
    
    return 0;
}

int cw221x_dump_register(void)
{
    int ret = 0;
    unsigned char reg_val = 0;
    int i = 0;

    for(i = 0; i <= 0xF; i++){
        cw_read(i, &reg_val);
        /*Please add print if use*/
        /*printf("0x%2x = 0x%2x\n", i, (int)reg_val);*/
    }
    for(i = 0xA0; i <= 0xAB; i++){
        cw_read(i, &reg_val);
        /*Please add print if use*/
        /*printf("0x%2x = 0x%2x\n", i, (int)reg_val);*/
    }
    return 0;
}

int cw221x_bat_init(uint8_t vbat_type)
{
    int ret;
    int loop = 0;
    //batt_type = bc_get_business_strategy_value(BUSINESS_STRATEGY_BATT_TYPE);
    batt_type = vbat_type;
    ret = cw221x_init();
    while((loop++ < 3) && (ret != 0))
    {
        ret = cw221x_init();
    }
    
    return ret;
}

